VERSION "0.1.0"

NS_ :

BS_:

BU_: MASTER SENSOR MOTORIO GEO APP

BO_ 220 MOTORIO_CMD: 4 MASTER
 SG_ MOTORIO_CMD_Direction : 0|8@1+ (1,0) [0|2] "" MOTORIO

BO_ 210 ULTRA_CMD: 4 SENSOR
 SG_ SENSOR_SONARS_FrontDistance : 0|8@1+ (1,0) [2|100] "" MASTER

BO_ 250 DISTANCE: 4 GEO
 SG_ DISTANCE_FinalDistance : 0|16@1+ (0.1,0) [0|0] "" MASTER

BO_ 37 GEO_HEARTBEAT: 1 GEO
 SG_ GEO_HEARTBEAT_signal : 0|8@1+ (1,0) [0|255] "" MASTER

BO_ 36 APP_HEARTBEAT: 1 APP
 SG_ APP_HEARTBEAT_signal : 0|8@1+ (1,0) [0|255] "" MASTER

BO_ 1 START_STOP: 1 APP
 SG_ BRIDGE_START_STOP : 0|8@1+ (1,0) [0|255] "cmd" MASTER

BO_ 108 BLUETOOTH_LAT_LONG: 8 APP
 SG_ GPS_Latitude : 0|31@1+ (0.000001,-90.000000) [-90|90] "" MASTER,GEO
 SG_ GPS_Longitude : 32|32@1+ (0.000001,-180.000000) [-180|180] "" MASTER,GEO

BA_DEF_ "BusType" STRING ;

BA_DEF_DEF_ "BusType" "CAN";

CM_ BU_ MASTER "The Master controller of the car";
CM_ BU_ MOTOR "The motor controller of the car";
CM_ BU_ SENSOR "The sensor controller of the car";
CM_ BU_ GEO "The Geo controller of the car";
CM_ BU_ APP "The Bluetooth/App controller of the car";
